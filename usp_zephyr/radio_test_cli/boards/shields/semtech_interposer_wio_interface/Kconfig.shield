## usp_zephyr/radio_test_cli/boards/shields/semtech_interposer_wio_interface/Kconfig.shield
```kconfig
config SHIELD_SEMTECH_INTERPOSER_WIO_INTERFACE
	def_bool $(shields_list_contains,semtech_interposer_wio_interface)
```

## usp_zephyr/radio_test_cli/boards/shields/semtech_nrf54l15dk_mbed_interposer/Kconfig.shield
```kconfig
config SHIELD_SEMTECH_NRF54L15DK_MBED_INTERPOSER
	def_bool $(shields_list_contains,semtech_nrf54l15dk_mbed_interposer)
```
